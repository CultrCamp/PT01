## main/Kconfig.projbuild
```kconfig
menu "Project Configuration"

    orsource "$IDF_PATH/examples/common_components/env_caps/$IDF_TARGET/Kconfig.env_caps"


    config THERMISTER1_GPIO
        int "Thermister1 GPIO number"
        range ENV_GPIO_RANGE_MIN ENV_GPIO_OUT_RANGE_MAX
        default 4
        help
            GPIO number (IOxx) to read thermister 1
            Some GPIOs are used for other purposes (flash connections, etc.) and cannot be used to blink.

    config THERMISTER2_GPIO
        int "Thermister2 GPIO number"
        range ENV_GPIO_RANGE_MIN ENV_GPIO_OUT_RANGE_MAX
        default 5
        help
            GPIO number (IOxx) to read thermister 2
            Some GPIOs are used for other purposes (flash connections, etc.) and cannot be used to blink.

    config BOOT_GPIO
        int "Boot pin GPIO number"
        range ENV_GPIO_RANGE_MIN ENV_GPIO_OUT_RANGE_MAX
        default 9
        help
            GPIO number (IOxx) to factory reset
            Some GPIOs are used for other purposes (flash connections, etc.) and cannot be used to blink.


endmenu
```
